#include <Arduino.h>
#include <ESP8266WiFi.h>
#include <WiFiServerSecure.h>
#include <lwip/napt.h>
#include <lwip/dns.h>
#include <EEPROM.h>
#include "device_creds.h" // generated by tools/gen_creds.sh from .env, do NOT commit

// ---- Config -----------------------------------------------------------
const uint16_t TLS_PORT = 8443;
// WIFI_SSID, WIFI_PASSWORD, AUTH_TOKEN, SOFTAP_SSID, SOFTAP_PASSWORD all
// come from device_creds.h, generated from .env. WIFI_SSID/PASSWORD are
// only used as the seed for known-network slot 0 on first boot -- after
// that, the EEPROM-stored list is the source of truth.

#define NAPT_MAX 64
#define NAPT_PORT_MAX 10

// ---- Known-network storage (EEPROM-emulated flash) ---------------------
#define MAX_NETWORKS 8
#define EEPROM_MAGIC 0xA5

struct KnownNetwork
{
  char ssid[33];
  char password[65];
  bool used;
};

struct StoredConfig
{
  uint8_t magic;
  KnownNetwork networks[MAX_NETWORKS];
  char softApPassword[65];
};

#define EEPROM_SIZE sizeof(StoredConfig)

StoredConfig config;
char currentStaSsid[33];
char currentStaPassword[65];
bool staStopped = false;

void saveConfig()
{
  EEPROM.put(0, config);
  EEPROM.commit();
}

void loadConfig()
{
  EEPROM.begin(EEPROM_SIZE);
  EEPROM.get(0, config);
  if (config.magic != EEPROM_MAGIC)
  {
    memset(&config, 0, sizeof(config));
    config.magic = EEPROM_MAGIC;
    strncpy(config.networks[0].ssid, WIFI_SSID, sizeof(config.networks[0].ssid) - 1);
    strncpy(config.networks[0].password, WIFI_PASSWORD, sizeof(config.networks[0].password) - 1);
    config.networks[0].used = true;
    strncpy(config.softApPassword, SOFTAP_PASSWORD, sizeof(config.softApPassword) - 1);
    saveConfig();
    Serial.println("EEPROM: first boot, seeded with compiled defaults");
  }
}

bool ssidInScanResults(const char *ssid)
{
  int n = WiFi.scanNetworks();
  bool found = false;
  for (int i = 0; i < n; i++)
  {
    if (WiFi.SSID(i) == ssid)
    {
      found = true;
      break;
    }
  }
  WiFi.scanDelete();
  return found;
}

// fullReset=false: touches only the STA link, AP is left completely alone.
// fullReset=true: tears down and rebuilds BOTH interfaces (used by RELOAD).
// AP is always guaranteed to come back up when fullReset=true, even if the
// STA reconnect itself fails -- otherwise a failed RELOAD could strand the
// device with no AP and no STA, unreachable except over USB.
bool connectToSta(const char *ssid, const char *password, uint32_t timeoutMs, bool fullReset)
{
  if (fullReset)
  {
    WiFi.softAPdisconnect(true);
    WiFi.disconnect(true);
    delay(200);
    WiFi.mode(WIFI_AP_STA);
  }
  else
  {
    WiFi.disconnect(false); // STA-only, explicit -- never rely on the default
    WiFi.mode(WIFI_AP_STA); // defensively reassert dual mode either way
  }
  delay(100);
  WiFi.begin(ssid, password);

  uint32_t start = millis();
  bool connected = false;
  while (millis() - start <= timeoutMs)
  {
    if (WiFi.status() == WL_CONNECTED)
    {
      connected = true;
      break;
    }
    delay(200);
  }
  if (connected)
  {
    strncpy(currentStaSsid, ssid, sizeof(currentStaSsid) - 1);
    strncpy(currentStaPassword, password, sizeof(currentStaPassword) - 1);
  }

  if (fullReset)
  {
    // AP was torn down above -- rebuild it regardless of whether STA
    // reconnected, so a failed reconnect never leaves the device with no
    // way to reach it remotely.
    WiFi.softAPDhcpServer().setDns(WiFi.dnsIP(0));
    WiFi.softAP(SOFTAP_SSID, config.softApPassword);
#if LWIP_FEATURES && !LWIP_IPV6
    err_t napt_ret = ip_napt_init(NAPT_MAX, NAPT_PORT_MAX);
    if (napt_ret == ERR_OK)
      ip_napt_enable_no(SOFTAP_IF, 1);
#endif
  }

  return connected;
}

// Scans for APs, then tries stored networks in storage order (not signal
// strength order) -- first stored entry that's actually visible wins.
// Used by RESTART -- always AP-preserving (fullReset=false), since RESTART
// should only ever touch the STA link.
bool connectFromStoredList()
{
  int n = WiFi.scanNetworks();
  for (int slot = 0; slot < MAX_NETWORKS; slot++)
  {
    if (!config.networks[slot].used)
      continue;
    for (int i = 0; i < n; i++)
    {
      if (WiFi.SSID(i) == config.networks[slot].ssid)
      {
        WiFi.scanDelete();
        return connectToSta(config.networks[slot].ssid, config.networks[slot].password, 15000, false);
      }
    }
  }
  WiFi.scanDelete();
  return false;
}

// ---- TLS server ---------------------------------------------------------
BearSSL::WiFiServerSecure server(TLS_PORT);
BearSSL::X509List serverCert(DEVICE_CERT_PEM);
BearSSL::PrivateKey serverKey(DEVICE_KEY_PEM);

// On this core version, setECCert takes (chain, cert_issuer_key_type, key).
// BR_KEYTYPE_EC is correct here because the cert is self-signed by the same
// EC key -- if you ever chain to an RSA-signed intermediate CA instead,
// this middle argument would need to be BR_KEYTYPE_RSA.

// Parses one argument starting at pos: either a "quoted phrase" (which may
// contain spaces) or a plain space-terminated token. Advances pos past the
// argument and returns it with surrounding quotes stripped.
String parseArg(const String &s, int &pos)
{
  while (pos < (int)s.length() && s[pos] == ' ')
    pos++;
  if (pos >= (int)s.length())
    return "";

  if (s[pos] == '"')
  {
    int end = s.indexOf('"', pos + 1);
    if (end == -1)
    {
      String arg = s.substring(pos + 1);
      pos = s.length();
      return arg;
    }
    String arg = s.substring(pos + 1, end);
    pos = end + 1;
    return arg;
  }

  int end = s.indexOf(' ', pos);
  if (end == -1)
    end = s.length();
  String arg = s.substring(pos, end);
  pos = end;
  return arg;
}

void setup()
{
  Serial.begin(115200);
  delay(200);
  Serial.printf("Heap at boot: %u\n", ESP.getFreeHeap());

  loadConfig();

  // AP_STA: stay connected to home WiFi as a station AND host our own
  // network at the same time -- this is what makes NAT between the two
  // possible at all.
  WiFi.mode(WIFI_AP_STA);
  bool connected = connectToSta(WIFI_SSID, WIFI_PASSWORD, 30000, false);
  if (!connected)
  {
    Serial.println("Initial STA connect failed after 30s -- retrying indefinitely");
    while (!connected)
    {
      delay(400);
      Serial.print(".");
      connected = (WiFi.status() == WL_CONNECTED);
    }
    strncpy(currentStaSsid, WIFI_SSID, sizeof(currentStaSsid) - 1);
    strncpy(currentStaPassword, WIFI_PASSWORD, sizeof(currentStaPassword) - 1);
  }
  Serial.println();
  Serial.print("STA IP: ");
  Serial.println(WiFi.localIP());

#if LWIP_FEATURES && !LWIP_IPV6
  // AP clients get DHCP info from the ESP by default, including a DNS
  // pointer to the ESP itself -- which can't resolve anything. Point it at
  // the real upstream DNS server we got from the STA connection instead,
  // or AP clients will get IP connectivity but no working hostnames.
  WiFi.softAPDhcpServer().setDns(WiFi.dnsIP(0));

  WiFi.softAP(SOFTAP_SSID, config.softApPassword);
  Serial.print("AP IP: ");
  Serial.println(WiFi.softAPIP());

  Serial.printf("Heap before NAPT init: %u\n", ESP.getFreeHeap());
  err_t napt_ret = ip_napt_init(NAPT_MAX, NAPT_PORT_MAX);
  Serial.printf("ip_napt_init: ret=%d (OK=%d)\n", (int)napt_ret, (int)ERR_OK);
  if (napt_ret == ERR_OK)
  {
    napt_ret = ip_napt_enable_no(SOFTAP_IF, 1);
    Serial.printf("ip_napt_enable_no(SOFTAP_IF): ret=%d\n", (int)napt_ret);
    if (napt_ret == ERR_OK)
    {
      Serial.println("NAT bridge active: AP clients now routed through STA uplink");
    }
  }
  if (napt_ret != ERR_OK)
  {
    Serial.println("NAPT setup FAILED -- AP clients will have no internet route");
  }
  Serial.printf("Heap after NAPT init: %u\n", ESP.getFreeHeap());
#else
  Serial.println("NAPT not available in this lwIP build -- AP hosted but not routed");
#endif

  server.setECCert(&serverCert, BR_KEYTYPE_EC, &serverKey);
  server.begin();
  Serial.println("TLS control server listening");
  Serial.printf("Heap after full setup: %u\n", ESP.getFreeHeap());
}

void handleClient(WiFiClientSecure &client)
{
  client.setTimeout(5000);

  String token = client.readStringUntil('\n');
  token.trim();
  if (token != AUTH_TOKEN)
  {
    client.println("AUTH_FAIL");
    client.stop();
    return;
  }
  client.println("AUTH_OK");

  while (client.connected())
  {
    if (client.available())
    {
      String cmd = client.readStringUntil('\n');
      cmd.trim();
      if (cmd.length() == 0)
        continue;

      if (cmd == "PING")
      {
        client.println("PONG");
      }
      else if (cmd == "STATUS")
      {
        client.print("uptime_ms=");
        client.println(millis());
      }
      else if (cmd == "QUIT")
      {
        client.println("BYE");
        client.flush();
        break;
      }
      else if (cmd.startsWith("NETADD "))
      {
        int pos = 7;
        while (pos < (int)cmd.length() && cmd[pos] == ' ')
          pos++;
        bool force = false;
        if (cmd.startsWith("-f", pos) && (pos + 2 == (int)cmd.length() || cmd[pos + 2] == ' '))
        {
          force = true;
          pos += 2;
        }
        String ssid = parseArg(cmd, pos);
        String pass = parseArg(cmd, pos);
        if (ssid.length() == 0 || pass.length() == 0)
        {
          client.println("ERR usage: NETADD [-f] <ssid> <password>  (quote either if it contains spaces; -f skips the range check)");
        }
        else
        {
          bool inRange = force || ssidInScanResults(ssid.c_str());
          if (!inRange)
          {
            client.println("ERR network not found in range, not saved");
          }
          else
          {
            int slot = -1;
            for (int i = 0; i < MAX_NETWORKS; i++)
            {
              if (ssid == config.networks[i].ssid)
              {
                slot = i;
                break;
              }
              if (slot == -1 && !config.networks[i].used)
                slot = i;
            }
            if (slot == -1)
            {
              client.println("ERR network storage full");
            }
            else
            {
              strncpy(config.networks[slot].ssid, ssid.c_str(), sizeof(config.networks[slot].ssid) - 1);
              strncpy(config.networks[slot].password, pass.c_str(), sizeof(config.networks[slot].password) - 1);
              config.networks[slot].used = true;
              saveConfig();
              client.println("OK network saved");
            }
          }
        }
      }
      else if (cmd.startsWith("PASSWD "))
      {
        String newPass = cmd.substring(7);
        if (newPass.length() < 8)
        {
          client.println("ERR password must be at least 8 characters");
        }
        else
        {
          strncpy(config.softApPassword, newPass.c_str(), sizeof(config.softApPassword) - 1);
          saveConfig();
          WiFi.softAP(SOFTAP_SSID, config.softApPassword);
          client.println("OK softAP password changed");
        }
      }
      else if (cmd == "RELOAD")
      {
        client.println("# Reloading STA and AP (you may be disconnected if using the SoftAP)...");
        client.flush();
        bool ok = connectToSta(currentStaSsid, currentStaPassword, 15000, true);
        client.println(ok ? "OK reconnected" : "ERR reconnect failed");
      }
      else if (cmd == "STOP")
      {
        WiFi.disconnect(false); // STA only, explicit -- AP is left untouched
        WiFi.mode(WIFI_AP_STA); // defensively reassert dual mode
        staStopped = true;
        client.println("OK station stopped, AP + control channel still up");
      }
      else if (cmd == "RESTART")
      {
        client.println("# Scanning stored networks...");
        client.flush();
        bool ok = connectFromStoredList();
        if (ok)
        {
          staStopped = false;
          client.println("OK reconnected to " + String(currentStaSsid));
        }
        else
        {
          client.println("ERR no known network in range");
        }
      }
      else if (cmd == "HELP")
      {
        client.println("# PING - check connectivity, replies PONG");
        client.println("# STATUS - device uptime in ms");
        client.println("# NETADD [-f] <ssid> <password> - save a network (quote if it has spaces; -f skips the in-range check, e.g. for a network you'll only reach later)");
        client.println("# PASSWD <new password> - change and persist the SoftAP password");
        client.println("# RELOAD - full reset of both STA and AP (drops SoftAP sessions)");
        client.println("# STOP - drop STA only, AP/control channel stays up");
        client.println("# RESTART - reconnect STA to the first known network in range");
        client.println("# LIST [-P] - list saved networks and status (-P also shows passwords)");
        client.println("# CONNECT <ssid> - connect to a saved network by name if in range");
        client.println("# DELETE <ssid> - remove a saved network from the list");
        client.println("# UPDATE <ssid> <new password> - change the stored password for a saved network");
        client.println("# QUIT - close this connection");
        client.println("OK");
      }
      else if (cmd == "LIST" || cmd.startsWith("LIST "))
      {
        bool showPasswords = cmd.indexOf("-P") != -1;
        int n = WiFi.scanNetworks();
        for (int i = 0; i < MAX_NETWORKS; i++)
        {
          if (!config.networks[i].used)
            continue;
          String status = "--";
          if (WiFi.status() == WL_CONNECTED && String(config.networks[i].ssid) == currentStaSsid)
          {
            status = "connected";
          }
          else
          {
            for (int j = 0; j < n; j++)
            {
              if (WiFi.SSID(j) == config.networks[i].ssid)
              {
                status = "in range";
                break;
              }
            }
          }
          String line = "# " + String(config.networks[i].ssid) + " [" + status + "]";
          if (showPasswords)
            line += " pass=" + String(config.networks[i].password);
          client.println(line);
        }
        WiFi.scanDelete();
        client.println("OK");
      }
      else if (cmd.startsWith("CONNECT "))
      {
        int pos = 8;
        String ssid = parseArg(cmd, pos);
        if (ssid.length() == 0)
        {
          client.println("ERR usage: CONNECT <ssid>");
        }
        else
        {
          int slot = -1;
          for (int i = 0; i < MAX_NETWORKS; i++)
          {
            if (config.networks[i].used && ssid == config.networks[i].ssid)
            {
              slot = i;
              break;
            }
          }
          if (slot == -1)
          {
            client.println("ERR not in list");
          }
          else if (!ssidInScanResults(ssid.c_str()))
          {
            client.println("ERR not in range");
          }
          else
          {
            client.println("# Connecting to " + ssid + "...");
            client.flush();
            bool ok = connectToSta(config.networks[slot].ssid, config.networks[slot].password, 15000, false);
            client.println(ok ? "OK connected to " + ssid : "ERR connect failed");
          }
        }
      }
      else if (cmd.startsWith("DELETE "))
      {
        int pos = 7;
        String ssid = parseArg(cmd, pos);
        if (ssid.length() == 0)
        {
          client.println("ERR usage: DELETE <ssid>");
        }
        else
        {
          int slot = -1;
          for (int i = 0; i < MAX_NETWORKS; i++)
          {
            if (config.networks[i].used && ssid == config.networks[i].ssid)
            {
              slot = i;
              break;
            }
          }
          if (slot == -1)
          {
            client.println("ERR not in list");
          }
          else
          {
            memset(&config.networks[slot], 0, sizeof(config.networks[slot]));
            saveConfig();
            client.println("OK network deleted");
          }
        }
      }
      else if (cmd.startsWith("UPDATE "))
      {
        int pos = 7;
        String ssid = parseArg(cmd, pos);
        String newPass = parseArg(cmd, pos);
        if (ssid.length() == 0 || newPass.length() == 0)
        {
          client.println("ERR usage: UPDATE <ssid> <new password>");
        }
        else if (newPass.length() < 8)
        {
          client.println("ERR password must be at least 8 characters");
        }
        else
        {
          int slot = -1;
          for (int i = 0; i < MAX_NETWORKS; i++)
          {
            if (config.networks[i].used && ssid == config.networks[i].ssid)
            {
              slot = i;
              break;
            }
          }
          if (slot == -1)
          {
            client.println("ERR not in list");
          }
          else
          {
            strncpy(config.networks[slot].password, newPass.c_str(), sizeof(config.networks[slot].password) - 1);
            saveConfig();
            client.println("OK password updated");
          }
        }
      }
      else
      {
        // Placeholder -- this is where actual GPIO / control commands go.
        client.println("ERR unknown command");
      }
      client.flush();
    }
    delay(5);
  }
  client.stop();
}

void loop()
{
  WiFiClientSecure client = server.available();
  if (client)
  {
    Serial.println("Client connected");
    handleClient(client);
    Serial.println("Client disconnected");
  }
  else
  {
    delay(10); // yield to WiFi/lwIP stack + feed the watchdog when idle
  }
}
